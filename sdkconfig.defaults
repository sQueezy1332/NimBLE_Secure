## sdkconfig.defaults
```kconfig
CONFIG_BT_ENABLED=y
CONFIG_BT_NIMBLE_ENABLED=y
CONFIG_BT_NIMBLE_SM_SC=y
CONFIG_BT_NIMBLE_SM_LEGACY=y
# CONFIG_BT_NIMBLE_SM_SC_ONLY=1
CONFIG_BT_NIMBLE_SM_LVL=4
CONFIG_BT_NIMBLE_LL_CFG_FEAT_LE_ENCRYPTION=y
CONFIG_BT_NIMBLE_TRANSPORT_EVT_SIZE=256
CONFIG_BT_NIMBLE_GAP_DEVICE_NAME_MAX_LEN=15
CONFIG_BT_NIMBLE_MAX_BONDS=6
CONFIG_BT_NIMBLE_MAX_CONNECTIONS=3
CONFIG_BT_CTRL_BLE_MAX_ACT=4
CONFIG_BT_NIMBLE_MAX_CCCDS=0
CONFIG_BT_NIMBLE_ENABLE_PERIODIC_SYNC=n
CONFIG_BT_NIMBLE_SMP_ID_RESET=n
CONFIG_BT_NIMBLE_NVS_PERSIST=n
CONFIG_BT_NIMBLE_STATIC_TO_DYNAMIC=n
CONFIG_BT_NIMBLE_MEMPOOL_RUNTIME_ALLOC=y
CONFIG_BT_NIMBLE_MEMPOOL_BLOCK_REUSED=y
CONFIG_BT_NIMBLE_GATT_MAX_PROCS=1
CONFIG_BT_NIMBLE_CRYPTO_STACK_MBEDTLS=y
CONFIG_BT_SMP_CRYPTO_STACK_MBEDTLS=y
CONFIG_BT_NIMBLE_HANDLE_REPEAT_PAIRING_DELETION=y
CONFIG_BT_NIMBLE_MAX_EXT_ADV_INSTANCES=0 # +1
CONFIG_BT_CTRL_DFT_TX_POWER_LEVEL_P20=y
# CONFIG_BT_NIMBLE_LL_CFG_FEAT_LE_2M_PHY=n
# CONFIG_BT_CTRL_COEX_PHY_CODED_TX_RX_TLIM_EN=n

CONFIG_LWIP_IPV6=n
# CONFIG_LWIP_ND6=n
CONFIG_LWIP_IP_FORWARD=n
# CONFIG_LWIP_IPV4_NAPT=y
# CONFIG_LWIP_IPV4_NAPT_PORTMAP=y
# CONFIG_LWIP_NUM_NETIF_CLIENT_DATA=y #mDNS
CONFIG_LWIP_SNTP_UPDATE_DELAY=43200000
CONFIG_HTTPD_ERR_RESP_NO_DELAY=y

CONFIG_ESPTOOLPY_HEADER_FLASHSIZE_UPDATE=y
CONFIG_ESPTOOLPY_BEFORE_NORESET=n
CONFIG_ESPTOOLPY_AFTER_NORESET=y
CONFIG_BOOTLOADER_APP_ROLLBACK_ENABLE=y
CONFIG_APP_ROLLBACK_ENABLE=y
CONFIG_APP_RETRIEVE_LEN_ELF_SHA=16

CONFIG_BOOTLOADER_WDT_ENABLE=y
CONFIG_BOOTLOADER_WDT_DISABLE_IN_USER_CODE=y
CONFIG_BOOTLOADER_WDT_TIME_MS=20000
CONFIG_ESP_TASK_WDT_EN=n
CONFIG_ESP_TASK_WDT_INIT=n
# CONFIG_ESP_TASK_WDT_PANIC=y
# CONFIG_ESP_TASK_WDT_TIMEOUT_S=5
CONFIG_ESP_SYSTEM_PANIC_PRINT_REBOOT=y
CONFIG_ESP_SYSTEM_PANIC_REBOOT_DELAY_SECONDS=10
CONFIG_ESP_SYSTEM_HW_STACK_GUARD=y
CONFIG_ESP_BROWNOUT_DET_LVL_SEL_5=y #2.76
CONFIG_ESP_WIFI_NVS_ENABLED=n
CONFIG_ESP_PHY_CALIBRATION_AND_DATA_STORAGE=n
CONFIG_ESP_PHY_RF_CAL_FULL=y
CONFIG_ESP_COEX_POWER_MANAGEMENT=n
CONFIG_ESP_EVENT_POST_FROM_ISR-n
CONFIG_ESP_TIMER_SUPPORTS_ISR_DISPATCH_METHOD=y
# CONFIG_ESP_MAIN_TASK_STACK_SIZE=7680

CONFIG_LIBC_NEWLIB=y
CONFIG_LIBC_NEWLIB_NANO_FORMAT=y
CONFIG_SPI_FLASH_ROM_IMPL=y

CONFIG_FREERTOS_CHECK_STACKOVERFLOW_NONE=y
CONFIG_FREERTOS_USE_TIMERS=n
CONFIG_FREERTOS_USE_TRACE_FACILITY=y
CONFIG_FREERTOS_USE_STATS_FORMATTING_FUNCTIONS=y
CONFIG_FREERTOS_USE_IDLE_HOOK=y

CONFIG_BOOTLOADER_WDT_DISABLE_IN_USER_CODE=y
```

## sdkconfig.defaults.esp32c3
```kconfig
CONFIG_BT_NIMBLE_50_FEATURE_SUPPORT=y
CONFIG_BT_NIMBLE_LL_CFG_FEAT_LE_CODED_PHY=y
CONFIG_BT_NIMBLE_LL_CFG_FEAT_LE_2M_PHY=n
CONFIG_BT_NIMBLE_EXT_ADV=y
CONFIG_BT_NIMBLE_SVC_GAP_DEVICE_NAME="esp32c3"

CONFIG_ESPTOOLPY_FLASHFREQ_80M=y
CONFIG_ESPTOOLPY_FLASHSIZE_4MB=y

CONFIG_PARTITION_TABLE_CUSTOM=y
CONFIG_PARTITION_TABLE_CUSTOM_FILENAME="partition_4mb_ota.csv"
CONFIG_PARTITION_TABLE_OFFSET=0x7000

CONFIG_RTC_CLK_SRC_INT_8MD256=y
CONFIG_RTC_CLK_CAL_CYCLES=3000
CONFIG_LWIP_LOCAL_HOSTNAME="esp32c3"
# CONFIG_USJ_ENABLE_USB_SERIAL_JTAG=y
# CONFIG_ESP_CONSOLE_USB_SERIAL_JTAG=y
CONFIG_ESP_CONSOLE_SECONDARY_NONE=y
# CONFIG_ESP_CONSOLE_UART_DEFAULT=y

CONFIG_FREERTOS_TASK_FUNCTION_WRAPPER=y
```
